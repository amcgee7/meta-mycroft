## gdp-src-build/meta-mycroft/conf/layer.conf
```bitbake
# We have a conf and classes directory, add to BBPATH
BBPATH .= ":${LAYERDIR}"

# We have recipes-* directories, add to BBFILES
BBFILES += "${LAYERDIR}/recipes-*/*/*.bb \
	${LAYERDIR}/recipes-*/*/*.bbappend"

BBFILE_COLLECTIONS += "mycroft"
BBFILE_PATTERN_mycroft = "^${LAYERDIR}/"
BBFILE_PRIORITY_mycroft = "6"
```
